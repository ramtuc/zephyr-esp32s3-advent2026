## apps/blinky-ext/sample.yaml
```yaml
sample:
  name: blinky-ext
  description: 外付け LED（IO7）を led0 として点滅させる
common:
  platform_allow:
    - esp32s3_devkitc/esp32s3/procpu
  integration_platforms:
    - esp32s3_devkitc/esp32s3/procpu
  build_only: true
  tags: advent2026
tests:
  advent.blinky_ext: {}
  # ボードのフラッシュ（16MB）に合わせた snippet を付けたビルド
  advent.blinky_ext.flash16m:
    required_snippets:
      - espressif-flash-16M
```

## apps/dt-overlay/sample.yaml
```yaml
sample:
  name: dt-overlay
  description: Device Tree の overlay の例（LED、I2C0、BME280 のノード）
common:
  platform_allow:
    - esp32s3_devkitc/esp32s3/procpu
  integration_platforms:
    - esp32s3_devkitc/esp32s3/procpu
  build_only: true
  tags: advent2026
tests:
  advent.dt_overlay: {}
  # I2C0 のピンを GPIO8/9 に付け替える overlay を足したビルド
  advent.dt_overlay.i2c0_gpio8_9:
    extra_args:
      - EXTRA_DTC_OVERLAY_FILE=i2c0-gpio8-9.overlay
```

## apps/kconfig-footprint/sample.yaml
```yaml
sample:
  name: kconfig-footprint
  description: Kconfig で ROM と RAM を削る例（設定ファイルを6通り）
common:
  platform_allow:
    - esp32s3_devkitc/esp32s3/procpu
  integration_platforms:
    - esp32s3_devkitc/esp32s3/procpu
  build_only: true
  tags: advent2026
tests:
  advent.kconfig_footprint.0_full:
    extra_args:
      - CONF_FILE=prj_0_full.conf
  advent.kconfig_footprint.1_no_net:
    extra_args:
      - CONF_FILE=prj_1_no_net.conf
  advent.kconfig_footprint.2_no_shell:
    extra_args:
      - CONF_FILE=prj_2_no_shell.conf
  advent.kconfig_footprint.3_log_minimal:
    extra_args:
      - CONF_FILE=prj_3_log_minimal.conf
  advent.kconfig_footprint.4_stacks:
    extra_args:
      - CONF_FILE=prj_4_stacks.conf
  advent.kconfig_footprint.5_no_console:
    extra_args:
      - CONF_FILE=prj_5_no_console.conf
```

## west.yml
```yaml
# Zephyr のワークスペースの manifest（west.yml）
#
#   west init -l zephyr-esp32s3-advent2026
#   west update
#
# Zephyr は v4.5.0 に固定し、モジュールは apps/ のビルドに要るものだけを取る。
# SPDX-License-Identifier: Apache-2.0

manifest:
  remotes:
    - name: zephyrproject-rtos
      url-base: https://github.com/zephyrproject-rtos

  projects:
    - name: zephyr
      remote: zephyrproject-rtos
      revision: v4.5.0
      import:
        # Zephyr の west.yml にあるモジュールのうち、ここに挙げたものだけを取る
        name-allowlist:
          - hal_espressif  # ESP32 の HAL（Wi-Fi などの blob もここから取る）
          - mbedtls        # ESP32 の Wi-Fi のドライバが使う
          - tf-psa-crypto  # mbedtls が使う
```
