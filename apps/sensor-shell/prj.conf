## sample.yaml
```
sample:
  name: sensor-shell
  description: sensor shell 入りのビルド
common:
  platform_allow:
    - esp32s3_devkitc/esp32s3/procpu
  integration_platforms:
    - esp32s3_devkitc/esp32s3/procpu
  build_only: true
  tags: advent2026
tests:
  advent.sensor_shell: {}
```

## prj.conf
```kconfig
CONFIG_SENSOR=y

# シェルと sensor shell
CONFIG_SHELL=y
CONFIG_SENSOR_SHELL=y
```

## src/main.c
```c
/*
 * sensor shell で、コードを書かずにセンサを読むためのアプリ
 * (main は何もしない。操作はシリアルのシェルから行う)
 *
 * SPDX-License-Identifier: Apache-2.0
 */

int main(void)
{
	return 0;
}
```
